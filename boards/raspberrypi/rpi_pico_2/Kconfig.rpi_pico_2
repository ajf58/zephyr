## boards/raspberrypi/rpi_pico_2/Kconfig.rpi_pico_2
```kconfig
# Copyright (c) 2021 Yonatan Schachter
# SPDX-License-Identifier: Apache-2.0

config BOARD_RPI_PICO_2
	select SOC_RP2040
```

## boards/raspberrypi/rpi_pico_2/rpi_pico_2_defconfig
```kconfig
CONFIG_SYS_CLOCK_HW_CYCLES_PER_SEC=125000000
CONFIG_SERIAL=y
CONFIG_CONSOLE=y
CONFIG_UART_CONSOLE=y
CONFIG_USE_DT_CODE_PARTITION=y
CONFIG_BUILD_OUTPUT_HEX=y
CONFIG_UART_INTERRUPT_DRIVEN=y
CONFIG_RESET=y
CONFIG_CLOCK_CONTROL=y
#CONFIG_NO_OPTIMIZATIONS=y
#CONFIG_DEBUG=y
#CONFIG_DEBUG_INFO=y
CONFIG_EARLY_CONSOLE=y
CONFIG_PLATFORM_SPECIFIC_INIT=y


CONFIG_CONSOLE=y
CONFIG_PRINTK=y
CONFIG_SERIAL=y
CONFIG_UART_CONSOLE=y
```

## boards/riscv/esp32c6_devkitc/Kconfig.board
```kconfig
# ESP32C6 devkitm board configuration

# Copyright (c) 2021 Espressif Systems (Shanghai) Co., Ltd.
# SPDX-License-Identifier: Apache-2.0

config BOARD_ESP32C6_DEVKITC
	bool "ESP32C6 Devkit-C Board"
	depends on SOC_SERIES_ESP32C6
```

## boards/riscv/esp32c6_devkitm/Kconfig.board
```kconfig
# ESP32C6 devkitm board configuration

# Copyright (c) 2021 Espressif Systems (Shanghai) Co., Ltd.
# SPDX-License-Identifier: Apache-2.0

config BOARD_ESP32C6_DEVKITC
	bool "ESP32C6 Devkit-C Board"
	depends on SOC_ESP32C6
	select CONSOLE_HAS_DRIVER
```

## boards/riscv/esp32c6_devkitm/Kconfig.defconfig
```kconfig
# ESP32C6 devkitm board configuration

# Copyright (c) 2021 Espressif Systems (Shanghai) Co., Ltd.
# SPDX-License-Identifier: Apache-2.0

config BOARD
	default "esp32c6_devkitc"
	depends on BOARD_ESP32C6_DEVKITC
```

## soc/espressif/esp32c6/Kconfig.soc
```kconfig
# Copyright (c) 2023 Espressif Systems (Shanghai) Co., Ltd.
# SPDX-License-Identifier: Apache-2.0

config SOC_SERIES_ESP32C6
	bool
	select SOC_FAMILY_ESPRESSIF_ESP32
	help
	  ESP32C6

config SOC_ESP32C6
	bool
	select SOC_SERIES_ESP32C6
	help
	  ESP32C6

config SOC_SERIES
	default "esp32c6" if SOC_SERIES_ESP32C6

config SOC
	default "esp32c6" if SOC_SERIES_ESP32C6

config SOC_PART_NUMBER
	default "ESP32C6" if SOC_ESP32C6

if SOC_SERIES_ESP32C6

config ESP32_PHY_MAX_WIFI_TX_POWER
	int "Max WiFi TX power (dBm)"
	range 10 20
	default 20
	help
	  Set maximum transmit power for WiFi radio. Actual transmit power for high
	  data rates may be lower than this setting.

config ESP32_PHY_MAX_TX_POWER
	int
	default ESP32_PHY_MAX_WIFI_TX_POWER

endif
```

## soc/raspberrypi/rp2xxx/Kconfig.defconfig
```kconfig
# Raspberry Pi RP20XX MCU line

# Copyright (c) 2021 Nordic Semiconductor ASA
# Copyright (c) 2021 Yonatan Schachter
# SPDX-License-Identifier: Apache-2.0

if SOC_SERIES_RP20XX || SOC_SERIES_RP23XX

rsource "Kconfig.defconfig.rp2*"

config NUM_IRQS
	default 26 if SOC_SERIES_RP20XX
	default 54 if SOC_SERIES_RP23XX

endif # SOC_SERIES_RP20XX || SOC_SERIES_RP23XX
```

## soc/raspberrypi/rp2xxx/Kconfig.soc
```kconfig
# Raspberry Pi RP2XXX MCU line

# Copyright (c) 2021 Nordic Semiconductor ASA
# Copyright (c) 2021 Yonatan Schachter
# SPDX-License-Identifier: Apache-2.0

config SOC_RP2040
	bool
	select SOC_SERIES_RP20XX

config SOC_RP2350
	bool
	select SOC_SERIES_RP23XX

config SOC_SERIES_RP20XX
	bool
	select SOC_FAMILY_RPI_PICO

config SOC_SERIES_RP23XX
	bool
	select SOC_FAMILY_RPI_PICO

config SOC_SERIES
	default "rp20xx" if SOC_SERIES_RP20XX
	default "rp23xx" if SOC_SERIES_RP23XX

config SOC
	default "rp2040" if SOC_RP2040
	default "rp2350" if SOC_RP2350
```
